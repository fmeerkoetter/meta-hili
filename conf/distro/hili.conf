## conf/distro/hili.conf
```bitbake
include poky.conf

# make use of binary hardening through the compiler/linker
require conf/distro/include/security_flags.inc

# create a "pure" systemd based system
DISTRO_FEATURES_append = " systemd"
VIRTUAL-RUNTIME_init_manager = "systemd"
DISTRO_FEATURES_BACKFILL_CONSIDERED = "sysvinit"
VIRTUAL-RUNTIME_initscripts = ""

# add gnu less so the output from systemctl/journalctl is readable
IMAGE_INSTALL_append = " less"

# remove some stuff poky added
DISTRO_FEATURES_remove = " 3g irda nfc"
```
